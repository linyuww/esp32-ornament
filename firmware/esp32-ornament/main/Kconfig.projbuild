## firmware/esp32-ornament/main/Kconfig.projbuild
```kconfig
menu "Codex Ornament"

config ORNAMENT_WIFI_SSID
    string "Wi-Fi SSID"
    default ""

config ORNAMENT_WIFI_PASSWORD
    string "Wi-Fi password"
    default ""

config ORNAMENT_BRIDGE_URL
    string "Bridge state URL"
    default "http://192.168.1.100:8787/state"

config ORNAMENT_BRIDGE_AUTO_MATCH_ON_BOOT
    bool "Auto-match bridge URL on boot"
    default y
    help
        After Wi-Fi connects, the ornament broadcasts a local discovery
        request and verifies the bridge /state endpoint. A discovered bridge
        URL is saved to NVS so PC IP changes do not require manual setup.

config ORNAMENT_BRIDGE_AUTO_MATCH_RETRY_MS
    int "Bridge auto-match retry interval in milliseconds"
    default 30000
    range 5000 600000
    help
        When bridge polling fails, retry automatic discovery at this cadence.

config ORNAMENT_BRIDGE_OFFLINE_FAILURES
    int "Consecutive bridge failures before offline"
    default 3
    range 1 20
    help
        Number of consecutive bridge state fetch failures required before the
        hardware panel and web console report the bridge as offline. Transient
        failures below this threshold keep showing the last good state.

config ORNAMENT_CONNECT_TIMEOUT_MS
    int "Wi-Fi connect timeout in milliseconds"
    default 60000
    range 5000 120000

config ORNAMENT_PROV_AP_PREFIX
    string "Provisioning SoftAP SSID prefix"
    default "Codex-Ornament"

config ORNAMENT_PROV_AP_PASSWORD
    string "Provisioning SoftAP password"
    default "codex1234"
    help
        Use at least 8 characters. Set empty for an open provisioning AP.

config ORNAMENT_PROV_AP_CHANNEL
    int "Provisioning SoftAP channel"
    default 1
    range 1 13

config ORNAMENT_PROV_SCAN_MAX
    int "Maximum Wi-Fi networks shown in provisioning portal"
    default 16
    range 4 32

config ORNAMENT_CONFIG_PORTAL_ENABLED
    bool "Enable Wi-Fi provisioning portal"
    depends on ESP_WIFI_SOFTAP_SUPPORT && LWIP_DHCPS
    default n
    help
        Builds the ESP32 SoftAP web portal for first-time Wi-Fi/bridge setup.
        Keep this disabled in the bridge-first firmware to avoid linking the
        HTTP server. Re-enable it for first-time setup or after erasing NVS.

config ORNAMENT_HOSTNAME_PREFIX
    string "Network hostname prefix"
    default "codex-ornament"
    help
        The firmware appends the last two STA MAC bytes, for example
        codex-ornament-4ad4.local.

config ORNAMENT_WEB_CONSOLE_ENABLED
    bool "Enable device web console"
    default n
    help
        Builds the ESP32-hosted LAN web console and /status endpoint. Keep this
        disabled in the bridge-first firmware to save flash/IRAM; use the local
        PC bridge endpoints for status and configuration instead.

config ORNAMENT_MDNS_ENABLED
    bool "Advertise local web console with mDNS"
    depends on ORNAMENT_WEB_CONSOLE_ENABLED
    default n

config ORNAMENT_POLL_INTERVAL_MS
    int "Bridge poll interval in milliseconds"
    default 3000
    range 1000 60000

config ORNAMENT_EXPIRED_QUOTA_RETRY_MS
    int "Expired quota refresh retry interval in milliseconds"
    default 30000
    range 500 60000
    help
        When the displayed quota reset time has already passed, poll the bridge
        at this faster cadence until a fresh reset time is fetched.

config ORNAMENT_UI_FRAME_MS
    int "Animated UI frame interval in milliseconds"
    default 250
    range 100 2000

config ORNAMENT_RICH_XIAOZHI_DISPLAY_ENABLED
    bool "Enable rich Xiaozhi display overlay"
    default y
    help
        Builds bundled Chinese fonts and enables UTF-8 rendering on the
        Xiaozhi assistant page. This is required for Chinese STT/TTS text.

menu "Page button"

config ORNAMENT_PAGE_BUTTON_ENABLED
    bool "Enable hardware page cycle button"
    default y
    help
        Enables a physical button that cycles the display through the fixed
        standby/clock, quota, and Xiaozhi assistant pages.

config ORNAMENT_PAGE_BUTTON_GPIO
    int "Page cycle button GPIO"
    depends on ORNAMENT_PAGE_BUTTON_ENABLED
    default 15
    help
        Connect one side of the button to this GPIO and the other side to
        GND when active-low mode is enabled.

config ORNAMENT_PAGE_BUTTON_ACTIVE_LOW
    bool "Button is active low"
    depends on ORNAMENT_PAGE_BUTTON_ENABLED
    default y
    help
        Enables the GPIO internal pull-up and treats a low level as pressed.

config ORNAMENT_PAGE_BUTTON_DEBOUNCE_MS
    int "Page button debounce in milliseconds"
    depends on ORNAMENT_PAGE_BUTTON_ENABLED
    default 50
    range 10 500

endmenu

menu "AI button"

config ORNAMENT_AI_BUTTON_ENABLED
    bool "Enable hardware AI start/stop button"
    default y
    help
        Enables a dedicated button that stops an active Xiaozhi conversation
        immediately, or toggles the session while the assistant page is active.

config ORNAMENT_AI_BUTTON_GPIO
    int "AI start/stop button GPIO"
    depends on ORNAMENT_AI_BUTTON_ENABLED
    default 16
    help
        Connect one side of the button to this GPIO and the other side to
        GND when active-low mode is enabled.

config ORNAMENT_AI_BUTTON_ACTIVE_LOW
    bool "AI button is active low"
    depends on ORNAMENT_AI_BUTTON_ENABLED
    default y
    help
        Enables the GPIO internal pull-up and treats a low level as pressed.

config ORNAMENT_AI_BUTTON_DEBOUNCE_MS
    int "AI button debounce in milliseconds"
    depends on ORNAMENT_AI_BUTTON_ENABLED
    default 50
    range 10 500

endmenu

config ORNAMENT_SNTP_SERVER
    string "SNTP server"
    default "pool.ntp.org"

config ORNAMENT_TIMEZONE
    string "POSIX timezone"
    default "CST-8"
    help
        POSIX timezone string used by localtime_r(). CST-8 means UTC+8.

config ORNAMENT_LOCAL_WEATHER_ENABLED
    bool "Fetch weather directly on device"
    default n
    help
        Builds the ESP32-side weather HTTP client. Keep this disabled in the
        bridge-first firmware because the local PC bridge already includes
        weather in /state.

config ORNAMENT_WEATHER_LABEL
    string "Default weather label"
    default "HAIDIAN"

config ORNAMENT_WEATHER_SOURCE
    string "Default local weather provider"
    default "caiyun"
    help
        Local weather provider. Supported values are caiyun and open-meteo.

config ORNAMENT_WEATHER_LAT_E6
    int "Default weather latitude scaled by 1e6"
    default 39995401
    range -90000000 90000000

config ORNAMENT_WEATHER_LON_E6
    int "Default weather longitude scaled by 1e6"
    default 116341625
    range -180000000 180000000

config ORNAMENT_WEATHER_FETCH_INTERVAL_MS
    int "Local weather refresh interval in milliseconds"
    default 600000
    range 60000 86400000

config ORNAMENT_WEATHER_RETRY_INTERVAL_MS
    int "Local weather retry interval in milliseconds"
    default 60000
    range 10000 3600000

config ORNAMENT_QUOTA_CRITICAL_PERCENT
    int "Critical quota percent"
    default 10
    range 0 100

config ORNAMENT_QUOTA_WARN_PERCENT
    int "Warning quota percent"
    default 25
    range 0 100

config ORNAMENT_DONE_FLASH_MS
    int "Task done ring flash duration in milliseconds"
    default 5000
    range 0 600000

config ORNAMENT_AUDIO_ENABLED
    bool "Enable I2S audio hardware"
    default y
    help
        Initializes the shared I2S speaker/microphone path used by music
        playback and Xiaozhi voice. This does not embed a task-done clip by
        itself.

config ORNAMENT_TASK_DONE_AUDIO_CLIP_ENABLED
    bool "Embed and play local task done PCM clip"
    depends on ORNAMENT_AUDIO_ENABLED
    default y
    help
        Embeds assets/task_done.pcm and plays it once when a new bridge done
        event is observed. Disable only for builds that intentionally rely on
        an external ASRPRO voice prompt or need the flash savings.

config ORNAMENT_AUDIO_PIN_BCLK
    int "MAX98357A I2S BCLK GPIO"
    default 4
    depends on ORNAMENT_AUDIO_ENABLED

config ORNAMENT_AUDIO_PIN_LRC
    int "MAX98357A I2S LRC/WS GPIO"
    default 5
    depends on ORNAMENT_AUDIO_ENABLED

config ORNAMENT_AUDIO_PIN_DIN
    int "MAX98357A I2S DIN GPIO"
    default 6
    depends on ORNAMENT_AUDIO_ENABLED

config ORNAMENT_AUDIO_VOLUME_PERCENT
    int "Speaker output volume percent"
    default 70
    range 0 100

menu "Xiaozhi AI voice"

config ORNAMENT_XIAOZHI_ENABLED
    bool "Enable Xiaozhi AI voice client"
    default y
    help
        Enables the Xiaozhi assistant page and session controls. The transport
        can run through the local bridge to save firmware space, or use the
        legacy direct WebSocket + Opus client for fallback testing.

choice ORNAMENT_XIAOZHI_TRANSPORT
    prompt "Xiaozhi transport"
    depends on ORNAMENT_XIAOZHI_ENABLED
    default ORNAMENT_XIAOZHI_TRANSPORT_BRIDGE

config ORNAMENT_XIAOZHI_TRANSPORT_BRIDGE
    bool "Local bridge proxy"
    help
        Use the PC bridge for Xiaozhi service integration. This keeps the ESP32
        firmware off the WebSocket and Opus dependencies.

config ORNAMENT_XIAOZHI_TRANSPORT_DIRECT
    bool "Direct WebSocket + Opus"
    help
        Build the original ESP32-side Xiaozhi WebSocket and Opus client. Use
        this only as a fallback because it costs substantially more flash.

endchoice

config ORNAMENT_XIAOZHI_WS_URL
    string "Xiaozhi WebSocket URL"
    depends on ORNAMENT_XIAOZHI_TRANSPORT_DIRECT
    default ""
    help
        WebSocket endpoint for a Xiaozhi-compatible server, for example a
        self-hosted xiaozhi-esp32-server endpoint. Leave empty to keep the
        client disabled at runtime.

config ORNAMENT_XIAOZHI_TOKEN
    string "Xiaozhi access token"
    depends on ORNAMENT_XIAOZHI_TRANSPORT_DIRECT
    default ""
    help
        Optional bearer token sent in the WebSocket Authorization header.

config ORNAMENT_XIAOZHI_AUTO_START
    bool "Start Xiaozhi session after Wi-Fi connects"
    depends on ORNAMENT_XIAOZHI_ENABLED
    default n

config ORNAMENT_XIAOZHI_CLIENT_ID
    string "Xiaozhi client ID override"
    depends on ORNAMENT_XIAOZHI_ENABLED
    default ""
    help
        Optional stable client ID. When empty, the ornament hostname is used.

config ORNAMENT_XIAOZHI_PROTOCOL_VERSION
    int "Xiaozhi binary protocol version"
    depends on ORNAMENT_XIAOZHI_TRANSPORT_DIRECT
    default 1
    range 1 1
    help
        Version 1 sends raw Opus frames in WebSocket binary messages.

config ORNAMENT_XIAOZHI_FRAME_MS
    int "Xiaozhi Opus frame duration in milliseconds"
    depends on ORNAMENT_XIAOZHI_TRANSPORT_DIRECT
    default 60
    range 20 60
    help
        Xiaozhi commonly uses 60 ms Opus frames at 16 kHz mono.

config ORNAMENT_XIAOZHI_OPUS_COMPLEXITY
    int "Xiaozhi Opus encoder complexity"
    depends on ORNAMENT_XIAOZHI_TRANSPORT_DIRECT
    default 3
    range 0 10

config ORNAMENT_XIAOZHI_WS_BUFFER_BYTES
    int "Xiaozhi WebSocket receive buffer bytes"
    depends on ORNAMENT_XIAOZHI_TRANSPORT_DIRECT
    default 2048
    range 1024 8192

config ORNAMENT_XIAOZHI_OPUS_MAX_BYTES
    int "Xiaozhi maximum Opus packet bytes"
    depends on ORNAMENT_XIAOZHI_TRANSPORT_DIRECT
    default 1500
    range 256 4096

config ORNAMENT_XIAOZHI_CONNECT_TIMEOUT_MS
    int "Xiaozhi connect and hello timeout in milliseconds"
    depends on ORNAMENT_XIAOZHI_TRANSPORT_DIRECT
    default 10000
    range 2000 60000

config ORNAMENT_XIAOZHI_BRIDGE_TIMEOUT_MS
    int "Xiaozhi bridge request timeout in milliseconds"
    depends on ORNAMENT_XIAOZHI_TRANSPORT_BRIDGE
    default 5000
    range 1000 30000

config ORNAMENT_XIAOZHI_MIC_PIN_DIN
    int "I2S microphone DOUT GPIO"
    depends on ORNAMENT_XIAOZHI_ENABLED
    default -1
    help
        Set to the I2S microphone data output GPIO. BCLK and WS reuse the
        speaker I2S pins so the microphone and speaker stay clock-compatible.

config ORNAMENT_XIAOZHI_MIC_SLOT_RIGHT
    bool "Read microphone samples from right I2S slot"
    depends on ORNAMENT_XIAOZHI_ENABLED
    default n
    help
        Enable when the I2S microphone is wired or strapped to transmit on the
        right channel. Left slot is used by default.

config ORNAMENT_XIAOZHI_MCP_ENABLED
    bool "Enable Xiaozhi MCP tool handling"
    depends on ORNAMENT_XIAOZHI_TRANSPORT_DIRECT
    default y
    help
        Advertise MCP capability in the Xiaozhi hello frame and handle
        inbound JSON-RPC tool calls for local music playback.

config ORNAMENT_MUSIC_PLAYER_ENABLED
    bool "Enable bridge-backed music playback"
    depends on ORNAMENT_AUDIO_ENABLED
    default y
    help
        Builds the raw-PCM music player that resolves and streams songs from
        the local PC bridge.

config ORNAMENT_MUSIC_REQUEST_TIMEOUT_MS
    int "Music HTTP request timeout in milliseconds"
    depends on ORNAMENT_MUSIC_PLAYER_ENABLED
    default 10000
    range 1000 60000

config ORNAMENT_MUSIC_STREAM_CHUNK_BYTES
    int "Music stream read chunk bytes"
    depends on ORNAMENT_MUSIC_PLAYER_ENABLED
    default 2048
    range 512 8192

config ORNAMENT_MUSIC_COVER_ENABLED
    bool "Fetch and cache music cover on device"
    depends on ORNAMENT_MUSIC_PLAYER_ENABLED
    default n
    help
        Downloads bridge-rendered RGB565 cover art and keeps it in the music
        snapshot. The bridge preprocesses artwork to a fixed 96x96 RGB565
        frame so the device does not need JPEG or PNG decoding.

endmenu

config ORNAMENT_STANDBY_CLOCK_MS
    int "Switch to standby clock page after idle milliseconds"
    default 60000
    range 0 3600000
    help
        Set 0 to disable the dedicated standby clock page. Idle status switches to clock after this duration.

config ORNAMENT_STANDBY_WALLPAPER_ENABLED
    bool "Embed standby wallpaper bitmap"
    default n
    help
        Builds the 240x240 RGB565 standby wallpaper into firmware. Keep this
        disabled in the bridge-first firmware to save flash; the standby page
        uses a lightweight procedural background instead.

config ORNAMENT_DISPLAY_DRIVER
    string "Display driver variant"
    default "st7789_spi"
    help
        Display module driver. The stock target is a 1.54 inch 240x240
        ST7789 SPI square TFT module. Use st77916_spi or st77916_qspi only
        when ORNAMENT_ST77916_DISPLAY_ENABLED is enabled.

config ORNAMENT_ST77916_DISPLAY_ENABLED
    bool "Build optional ST77916 LCD driver support"
    default n
    help
        Adds support for ST77916 SPI/QSPI panels and the Truly initialization
        sequence used during LCD bring-up. Leave disabled for the stock ST7789
        ornament to avoid extra component dependencies and flash usage.

config ORNAMENT_LCD_SPI_HOST
    int "LCD SPI host"
    default 2
    help
        SPI2_HOST is normally 1 and SPI3_HOST is normally 2 in ESP-IDF enum values.

config ORNAMENT_LCD_H_RES
    int "LCD horizontal resolution"
    default 240

config ORNAMENT_LCD_V_RES
    int "LCD vertical resolution"
    default 240

config ORNAMENT_LCD_PIXEL_CLOCK_HZ
    int "LCD pixel clock Hz"
    default 20000000

config ORNAMENT_LCD_PIN_SCLK
    int "LCD SCLK GPIO"
    default 12

config ORNAMENT_LCD_PIN_MOSI
    int "LCD IO0 GPIO for QSPI"
    default 11

config ORNAMENT_LCD_PIN_MISO
    int "LCD IO1 GPIO for QSPI"
    default -1

config ORNAMENT_LCD_PIN_D2
    int "LCD IO2 GPIO for QSPI"
    default -1

config ORNAMENT_LCD_PIN_D3
    int "LCD IO3 GPIO for QSPI"
    default -1

config ORNAMENT_LCD_PIN_CS
    int "LCD CS GPIO"
    default 10

config ORNAMENT_LCD_PIN_DC
    int "LCD DC GPIO for SPI"
    default 13
    help
        1.54 inch ST7789 SPI module DC pin.

config ORNAMENT_LCD_PIN_RST
    int "LCD RST GPIO"
    default 8

config ORNAMENT_LCD_PIN_BL
    int "LCD backlight control GPIO"
    default 7

config ORNAMENT_LCD_BL_ACTIVE_LEVEL
    int "LCD backlight active GPIO level"
    default 1
    range 0 1
    help
        Set 1 for active-high backlight enable. Set 0 only for adapter boards
        with active-low backlight enable.

config ORNAMENT_LCD_BOOT_TEST_MS
    int "LCD boot test pattern duration in milliseconds"
    default 0
    range 0 10000
    help
        Shows full-screen color test frames after LCD initialization. Set 0
        for normal production boot.

config ORNAMENT_LCD_SWAP_COLOR_BYTES
    bool "Swap RGB565 color bytes before LCD transfer"
    default y
    help
        Most ESP LCD SPI paths expect high byte first for RGB565 transfers.
        Disable only if colors are incorrect on the selected panel driver.

config ORNAMENT_LCD_SWAP_XY
    bool "Swap LCD X/Y address scan direction"
    depends on ORNAMENT_ST77916_DISPLAY_ENABLED
    default y
    help
        Enable when an ST77916 panel consumes row chunks as column chunks.

config ORNAMENT_LCD_REFERENCE_TEST_ONLY
    bool "Hold LCD reference test chart"
    depends on ORNAMENT_ST77916_DISPLAY_ENABLED
    default n
    help
        Draw a fixed reference chart and keep it on screen for panel bring-up.
        This intentionally blocks the application and should stay disabled in
        production firmware.

endmenu
```
