## firmware/esp32-ornament/sdkconfig.defaults
```kconfig
CONFIG_IDF_TARGET="esp32s3"
CONFIG_ESPTOOLPY_FLASHSIZE_16MB=y
CONFIG_ESPTOOLPY_FLASHSIZE="16MB"
CONFIG_PARTITION_TABLE_CUSTOM=y
CONFIG_PARTITION_TABLE_CUSTOM_FILENAME="partitions.csv"
CONFIG_PARTITION_TABLE_FILENAME="partitions.csv"
CONFIG_SPIRAM=y
CONFIG_SPIRAM_MODE_OCT=y
CONFIG_SPIRAM_SPEED_80M=y
CONFIG_SPIRAM_USE_MALLOC=y
CONFIG_SPIRAM_MALLOC_ALWAYSINTERNAL=16384
CONFIG_SPIRAM_MALLOC_RESERVE_INTERNAL=65536
CONFIG_COMPILER_OPTIMIZATION_SIZE=y
CONFIG_NEWLIB_NANO_FORMAT=y
CONFIG_LOG_DEFAULT_LEVEL_INFO=y
CONFIG_LWIP_DNS_SUPPORT_MDNS_QUERIES=y
# CONFIG_LWIP_DHCPS is not set
# CONFIG_LWIP_IPV6 is not set
# CONFIG_ESP_WIFI_SOFTAP_SUPPORT is not set
# CONFIG_ESP_WIFI_ENABLE_WPA3_SAE is not set
# CONFIG_ESP_WIFI_ENABLE_WPA3_OWE_STA is not set
# CONFIG_ESP_WIFI_ENTERPRISE_SUPPORT is not set
CONFIG_HTTPD_MAX_REQ_HDR_LEN=2048
CONFIG_HTTPD_MAX_URI_LEN=1024
CONFIG_ORNAMENT_CONFIG_PORTAL_ENABLED=n
CONFIG_ORNAMENT_HOSTNAME_PREFIX="codex-ornament"
CONFIG_ORNAMENT_WEB_CONSOLE_ENABLED=y
CONFIG_ORNAMENT_MDNS_ENABLED=y
CONFIG_ORNAMENT_UI_FRAME_MS=250
CONFIG_ORNAMENT_RICH_XIAOZHI_DISPLAY_ENABLED=n
CONFIG_ORNAMENT_PAGE_BUTTON_ENABLED=y
CONFIG_ORNAMENT_PAGE_BUTTON_GPIO=15
CONFIG_ORNAMENT_PAGE_BUTTON_ACTIVE_LOW=y
CONFIG_ORNAMENT_PAGE_BUTTON_DEBOUNCE_MS=50
CONFIG_ORNAMENT_AI_BUTTON_ENABLED=y
CONFIG_ORNAMENT_AI_BUTTON_GPIO=16
CONFIG_ORNAMENT_AI_BUTTON_ACTIVE_LOW=y
CONFIG_ORNAMENT_AI_BUTTON_DEBOUNCE_MS=50
CONFIG_ORNAMENT_DONE_FLASH_MS=5000
CONFIG_ORNAMENT_STANDBY_CLOCK_MS=60000
CONFIG_ORNAMENT_STANDBY_WALLPAPER_ENABLED=n
CONFIG_ORNAMENT_DISPLAY_DRIVER="st7789_spi"
CONFIG_ORNAMENT_LCD_H_RES=240
CONFIG_ORNAMENT_LCD_V_RES=240
CONFIG_ORNAMENT_LCD_PIXEL_CLOCK_HZ=20000000
CONFIG_ORNAMENT_LCD_PIN_SCLK=12
CONFIG_ORNAMENT_LCD_PIN_MOSI=11
CONFIG_ORNAMENT_LCD_PIN_MISO=-1
CONFIG_ORNAMENT_LCD_PIN_D2=-1
CONFIG_ORNAMENT_LCD_PIN_D3=-1
CONFIG_ORNAMENT_LCD_PIN_CS=10
CONFIG_ORNAMENT_LCD_PIN_DC=13
CONFIG_ORNAMENT_LCD_PIN_RST=8
CONFIG_ORNAMENT_LCD_PIN_BL=7
CONFIG_ORNAMENT_ASRPRO_UART_ENABLED=y
CONFIG_ORNAMENT_ASRPRO_DONE_NOTIFY=y
CONFIG_ORNAMENT_ASRPRO_VOICE_COMMANDS=y
CONFIG_ORNAMENT_ASRPRO_UART_NUM=1
CONFIG_ORNAMENT_ASRPRO_UART_BAUD=9600
CONFIG_ORNAMENT_ASRPRO_UART_TX_GPIO=17
CONFIG_ORNAMENT_ASRPRO_UART_RX_GPIO=18
CONFIG_ORNAMENT_ASRPRO_DONE_TRIGGER="codex_done"
CONFIG_ORNAMENT_ASRPRO_DONE_SUFFIX=""
CONFIG_ORNAMENT_ASRPRO_TX_WAIT_MS=100
CONFIG_ORNAMENT_AUDIO_ENABLED=y
CONFIG_ORNAMENT_TASK_DONE_AUDIO_CLIP_ENABLED=n
CONFIG_ORNAMENT_AUDIO_PIN_BCLK=4
CONFIG_ORNAMENT_AUDIO_PIN_LRC=5
CONFIG_ORNAMENT_AUDIO_PIN_DIN=6
CONFIG_ORNAMENT_AUDIO_VOLUME_PERCENT=70
CONFIG_ORNAMENT_LOCAL_WEATHER_ENABLED=n
CONFIG_ORNAMENT_XIAOZHI_ENABLED=y
CONFIG_ORNAMENT_XIAOZHI_TRANSPORT_BRIDGE=y
# CONFIG_ORNAMENT_XIAOZHI_TRANSPORT_DIRECT is not set
# CONFIG_ORNAMENT_XIAOZHI_AUTO_START is not set
CONFIG_ORNAMENT_XIAOZHI_CLIENT_ID=""
CONFIG_ORNAMENT_XIAOZHI_BRIDGE_TIMEOUT_MS=5000
CONFIG_ORNAMENT_XIAOZHI_MIC_PIN_DIN=14
# CONFIG_ORNAMENT_XIAOZHI_MIC_SLOT_RIGHT is not set
CONFIG_ORNAMENT_MUSIC_PLAYER_ENABLED=y
CONFIG_ORNAMENT_MUSIC_REQUEST_TIMEOUT_MS=10000
CONFIG_ORNAMENT_MUSIC_STREAM_CHUNK_BYTES=2048
CONFIG_ORNAMENT_MUSIC_COVER_ENABLED=n
CONFIG_FREERTOS_WATCHPOINT_END_OF_STACK=y
CONFIG_COMPILER_STACK_CHECK_MODE_NORM=y
CONFIG_ESP_MAIN_TASK_STACK_SIZE=8192
CONFIG_FREERTOS_TASK_CREATE_ALLOW_EXT_MEM=y
CONFIG_MBEDTLS_DYNAMIC_BUFFER=y
CONFIG_MBEDTLS_EXTERNAL_MEM_ALLOC=y
CONFIG_MBEDTLS_SSL_OUT_CONTENT_LEN=2048
# CONFIG_MBEDTLS_SSL_KEEP_PEER_CERTIFICATE is not set
# CONFIG_MBEDTLS_SSL_RENEGOTIATION is not set
```
